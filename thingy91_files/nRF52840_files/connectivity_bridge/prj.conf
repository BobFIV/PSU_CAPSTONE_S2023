## CMakeLists.txt
```
#
# Copyright (c) 2020 Nordic Semiconductor
#
# SPDX-License-Identifier: LicenseRef-Nordic-5-Clause
#

cmake_minimum_required(VERSION 3.20.0)

find_package(Zephyr REQUIRED HINTS $ENV{ZEPHYR_BASE})
project(NONE)

# NORDIC SDK APP START
target_sources(app PRIVATE src/main.c)
# NORDIC SDK APP END

# Include application events and disk files
zephyr_library_include_directories(
  src/events
  )

# Application sources
add_subdirectory(src/disk)
add_subdirectory(src/events)
add_subdirectory(src/modules)
```

## sample.yaml
```
sample:
  description: Connectivity Bridge application
  name: Connectivity Bridge
tests:
  applications.connectivity_bridge:
    build_only: true
    platform_allow: thingy91_nrf52840
    integration_platforms:
      - thingy91_nrf52840
    tags: ci_build
```

## prj.conf
```kconfig
# General
CONFIG_REBOOT=y
CONFIG_HEAP_MEM_POOL_SIZE=8192
CONFIG_SYSTEM_WORKQUEUE_STACK_SIZE=2048
CONFIG_MAIN_STACK_SIZE=2048
CONFIG_GPIO=y
CONFIG_POLL=y
CONFIG_BOOTLOADER_MCUBOOT=y
CONFIG_APP_EVENT_MANAGER=y
CONFIG_SPEED_OPTIMIZATIONS=y
CONFIG_PM_DEVICE=y

# Features
CONFIG_BRIDGE_CDC_ENABLE=y
CONFIG_BRIDGE_MSC_ENABLE=y
CONFIG_BRIDGE_BLE_ENABLE=y

 # USB
CONFIG_USB_DEVICE_STACK=y
CONFIG_USB_DEVICE_REMOTE_WAKEUP=n
CONFIG_USB_DEVICE_MANUFACTURER="Nordic Semiconductor"
CONFIG_USB_DEVICE_PRODUCT="Thingy:91 UART"
CONFIG_USB_DEVICE_VID=0x1915
CONFIG_USB_DEVICE_PID=0x9100
CONFIG_USB_DEVICE_SN="THINGY91 12PLACEHLDRS" # This is overridden at runtime
CONFIG_USB_COMPOSITE_DEVICE=y
CONFIG_USB_CDC_ACM_RINGBUF_SIZE=16384

# Disk and file system
CONFIG_DISK_ACCESS=y
CONFIG_DISK_DRIVER_RAM=y
CONFIG_DISK_RAM_VOLUME_SIZE=64
CONFIG_FILE_SYSTEM=y
CONFIG_FAT_FILESYSTEM_ELM=y
CONFIG_FS_FATFS_LFN=y

# Settings
CONFIG_FCB=y
CONFIG_SETTINGS=y
CONFIG_SETTINGS_FCB=y
CONFIG_FLASH=y
CONFIG_FLASH_PAGE_LAYOUT=y
CONFIG_FLASH_MAP=y
CONFIG_MPU_ALLOW_FLASH_WRITE=y

# Logging
CONFIG_LOG=y
CONFIG_USE_SEGGER_RTT=y
CONFIG_LOG_BACKEND_RTT=y
CONFIG_LOG_BACKEND_RTT_MODE_DROP=y

# Event logs
CONFIG_BRIDGE_LOG_MODULE_STATE_EVENT=n
CONFIG_BRIDGE_LOG_UART_DATA_EVENT=n
CONFIG_BRIDGE_LOG_CDC_DATA_EVENT=n
CONFIG_BRIDGE_LOG_BLE_DATA_EVENT=n
CONFIG_BRIDGE_LOG_BLE_CTRL_EVENT=n
CONFIG_BRIDGE_LOG_PEER_CONN_EVENT=n
CONFIG_BRIDGE_LOG_FS_EVENT=n
CONFIG_BRIDGE_LOG_POWER_DOWN_EVENT=n

 # UART
CONFIG_SERIAL=y
CONFIG_UART_INTERRUPT_DRIVEN=y
CONFIG_UART_0_INTERRUPT_DRIVEN=n
CONFIG_UART_1_INTERRUPT_DRIVEN=n
CONFIG_UART_LINE_CTRL=y
CONFIG_UART_ASYNC_API=y
CONFIG_UART_0_ASYNC=y
CONFIG_UART_1_ASYNC=y
CONFIG_UART_0_NRF_HW_ASYNC=y
CONFIG_UART_1_NRF_HW_ASYNC=y
CONFIG_UART_0_NRF_HW_ASYNC_TIMER=1
CONFIG_UART_1_NRF_HW_ASYNC_TIMER=2
CONFIG_NRFX_UARTE0=y
CONFIG_NRFX_UARTE1=y
CONFIG_NRFX_TIMER1=y
CONFIG_NRFX_TIMER2=y
CONFIG_NRFX_PPI=y

# BLE
CONFIG_BT=y
CONFIG_BT_DEVICE_NAME="Thingy:91 UART"
CONFIG_BT_DEVICE_NAME_DYNAMIC=y
CONFIG_BT_PERIPHERAL=y
CONFIG_BT_PERIPHERAL_PREF_MIN_INT=6
CONFIG_BT_PERIPHERAL_PREF_MAX_INT=16
CONFIG_BT_PERIPHERAL_PREF_LATENCY=0
CONFIG_BT_PERIPHERAL_PREF_TIMEOUT=400
CONFIG_BT_BONDABLE=n
CONFIG_BT_LL_SOFTDEVICE=y
CONFIG_BT_MAX_CONN=1
CONFIG_BT_AUTO_PHY_UPDATE=y
CONFIG_BT_DATA_LEN_UPDATE=y
CONFIG_BT_HCI_ACL_FLOW_CONTROL=y
CONFIG_BT_L2CAP_TX_MTU=247
CONFIG_BT_BUF_ACL_RX_SIZE=251
CONFIG_BT_NUS=y
CONFIG_BT_GATT_CLIENT=y
CONFIG_BT_SMP=y
CONFIG_BT_CTLR=y
CONFIG_BT_CTLR_RX_BUFFERS=10
CONFIG_BT_BUF_ACL_TX_COUNT=10
CONFIG_BT_BUF_ACL_TX_SIZE=251
CONFIG_BT_CTLR_DATA_LENGTH_MAX=251
```

## app.overlay
```dts
/*
 * Copyright (c) 2021 Nordic Semiconductor ASA
 *
 * SPDX-License-Identifier: LicenseRef-Nordic-5-Clause
 */

&zephyr_udc0 {
	cdc_acm_uart0: cdc_acm_uart0 {
		compatible = "zephyr,cdc-acm-uart";
	};

	cdc_acm_uart1: cdc_acm_uart1 {
		compatible = "zephyr,cdc-acm-uart";
	};
};
```

## src/main.c
```c
/*
 * Copyright (c) 2020 Nordic Semiconductor ASA
 *
 * SPDX-License-Identifier: LicenseRef-Nordic-5-Clause
 */

#include <zephyr/kernel.h>

#include <app_event_manager.h>

#define MODULE main
#include "module_state_event.h"

#include <zephyr/logging/log.h>
LOG_MODULE_REGISTER(MODULE);

// Start test includes
#include <stdio.h>
#include <string.h>
#include <zephyr/types.h>
#include <zephyr/fs/fs.h>
#include <ff.h>

#include "module_state_event.h"
#include "fs_event.h"
#include "power_event.h"

#include <zephyr/logging/log.h>
#include <stdio.h>
#include <assert.h>

#include <fs_event.h>
#include <zephyr/fs/fs.h>
#define FILE_CONTENTS     file_contents
#define FILE_CONTENTS_LEN strlen(file_contents)
#define FILE_NAME         "TEST.TXT"
static const char file_contents[] = 
	"Test.\r\n"
	;
#define FATFS_MNTP	"/" CONFIG_MASS_STORAGE_DISK_NAME ":"

static FATFS fat_fs;

static struct fs_mount_t fatfs_mnt = {
	.type = FS_FATFS,
	.mnt_point = FATFS_MNTP,
	.fs_data = &fat_fs,
};
// End

#define USB_SERIALNUMBER_TEMPLATE "THINGY91_%04X%08X"

static uint8_t usb_serial_str[] = "THINGY91_12PLACEHLDRS";

/* Overriding weak function to set iSerialNumber at runtime. */
uint8_t *usb_update_sn_string_descriptor(void)
{
	snprintk(usb_serial_str, sizeof(usb_serial_str), USB_SERIALNUMBER_TEMPLATE,
				(uint32_t)(NRF_FICR->DEVICEADDR[1] & 0x0000FFFF)|0x0000C000,
				(uint32_t)NRF_FICR->DEVICEADDR[0]);

	return usb_serial_str;
}

/*int write_test_text() {
	int err;

	err = fs_mount(&fatfs_mnt);
	if (err) {
		LOG_ERR("fs_mount: %d", err);
		return false;
	}

	struct fs_file_t file;
	ssize_t bytes_written;
	char fname[128];

	
	err = snprintf(fname, sizeof(fname), "%s/%s", FATFS_MNTP, FILE_NAME);
	if (err <= 0 || err > sizeof(fname)) {
		return -ENOMEM;
	}

	fs_file_t_init(&file);
	err = fs_open(&file, fname, FS_O_CREATE | FS_O_RDWR);
	if (err) {
		return err;
	}

	err = fs_seek(&file, 0, FS_SEEK_END);
	if (err) {
		return err;
	}

	bytes_written = fs_write(&file, FILE_CONTENTS, FILE_CONTENTS_LEN);
	if (bytes_written != FILE_CONTENTS_LEN) {
		return -ENOMEM;
	}

	err = fs_close(&file);
	if (err) {
		return err;
	}
	
	err = fs_unmount(&fatfs_mnt);

	return 0;
}*/

void main(void)
{
	if (app_event_manager_init()) {
		LOG_ERR("Application Event Manager not initialized");
	} else {
		module_set_state(MODULE_STATE_READY);
	}
	
	//write_test_text();
}
```
